## Project2/cucumber/board2/sdkconfig.defaults
```kconfig
CONFIG_ESPTOOLPY_FLASHSIZE_4MB=y
CONFIG_ESP_CONSOLE_UART_BAUDRATE=115200
CONFIG_CUCUMBER_BOARD_ID=2
CONFIG_CUCUMBER_HOSTNAME="cucumber-2"
```

## Project2/cucumber/board3/sdkconfig.defaults
```kconfig
CONFIG_ESPTOOLPY_FLASHSIZE_4MB=y
CONFIG_ESP_CONSOLE_UART_BAUDRATE=115200
CONFIG_CUCUMBER_BOARD_ID=3
CONFIG_CUCUMBER_HOSTNAME="cucumber-3"
CONFIG_CUCUMBER_OWNER_NAME="June"
```

## Project2/cucumber/board4/sdkconfig.defaults
```kconfig
CONFIG_ESPTOOLPY_FLASHSIZE_4MB=y
CONFIG_ESP_CONSOLE_UART_BAUDRATE=115200
CONFIG_CUCUMBER_BOARD_ID=4
CONFIG_CUCUMBER_HOSTNAME="cucumber-4"
CONFIG_CUCUMBER_OWNER_NAME="Windy"
```

## Project2/cucumber/common/cucumber_app/Kconfig
```kconfig
menu "Cucumber Project 2 settings"

config CUCUMBER_BOARD_ID
    int "Cucumber board ID"
    range 1 4
    default 1

config CUCUMBER_HOSTNAME
    string "DHCP hostname"
    default "cucumber-1"

config CUCUMBER_OWNER_NAME
    string "Board owner name"
    default "Nuch"

endmenu
```

## Project2/raspberry-pi/meta-adv-embedded-p2/conf/layer.conf
```bitbake
# Project 2 course layer.
BBPATH .= ":${LAYERDIR}"
BBFILES += "${LAYERDIR}/recipes-*/*/*.bb ${LAYERDIR}/recipes-*/*/*.bbappend"
BBFILE_COLLECTIONS += "advembeddedp2"
BBFILE_PATTERN_advembeddedp2 = "^${LAYERDIR}/"
BBFILE_PRIORITY_advembeddedp2 = "7"
LAYERSERIES_COMPAT_advembeddedp2 = "kirkstone langdale mickledore nanbield scarthgap"
LAYERDEPENDS_advembeddedp2 = "core openembedded-layer"
```
